#include <behaviors.dtsi>
#include <dt-bindings/zmk/keys.h>
#include <dt-bindings/zmk/bt.h>


/* Layers */
#define DEF_L 0
#define NAV_L 1
#define UPP_L 2
#define SYM_L 3
#define NUM_L 4

/* Behavior Settings */
&caps_word {
  continue-list = <UNDERSCORE MINUS BACKSPACE>;
};

&sk {
  release-after-ms = <60000>;
};
