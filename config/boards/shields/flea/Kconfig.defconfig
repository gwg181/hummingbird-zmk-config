## config/boards/shields/flea/Kconfig.defconfig
```kconfig
# Copyright (c) 2020 The ZMK Contributors
# SPDX-License-Identifier: MIT

if SHIELD_FLEA_LEFT

config ZMK_KEYBOARD_NAME
	default "FLEA_L"

config ZMK_SPLIT_BLE_ROLE_CENTRAL
	default y

endif

if SHIELD_FLEA_RIGHT

config ZMK_KEYBOARD_NAME
	default "FLEA_R"

endif

if SHIELD_FLEA_RIGHT || SHIELD_FLEA_LEFT

config ZMK_SPLIT
	default y

endif
```

## config/boards/shields/flea/Kconfig.shield
```kconfig
# Copyright (c) 2020 The ZMK Contributors
# SPDX-License-Identifier: MIT

config SHIELD_FLEA_LEFT
	def_bool $(shields_list_contains,flea_left)

config SHIELD_FLEA_RIGHT
	def_bool $(shields_list_contains,flea_right)
```

## config/boards/shields/moon/Kconfig.defconfig
```kconfig
# Copyright (c) 2020 The ZMK Contributors
# SPDX-License-Identifier: MIT

if SHIELD_MOON

config ZMK_KEYBOARD_NAME
    default "Moon"

config ZMK_USB
    default y

endif
```
